## firmware/esp32/components/a01nyub/Kconfig
```kconfig
menu "A01NYUB Sensor"

    config A01NYUB_DEFAULT_UART_PORT
        int "Default UART port"
        default 1
        range 0 2

    config A01NYUB_DEFAULT_RX_PIN
        int "Default RX pin"
        default 2
        range 0 39

    config A01NYUB_DEFAULT_TX_PIN
        int "Default TX pin"
        default 3
        range 0 39

    config A01NYUB_DEFAULT_MODE_FILTERED
        bool "Use filtered mode by default"
        default y
        help
            y = filtered/processed data (TX pin HIGH)
            n = realtime raw data (TX pin LOW)

    config A01NYUB_DEFAULT_READ_CONTINUOUS
        bool "Use continuous mode by default"
        default y
        help
            y = continuous non-blocking reading
            n = one-shot blocking reading

endmenu
```

## firmware/esp32/components/status_led/Kconfig
```kconfig
menu "Status LED"

    choice STATUS_LED_TYPE
        prompt "LED type"
        default STATUS_LED_TYPE_WS2812
        help
            What the status LED is. The ESP32-C6-DevKit carries one WS2812 RGB
            LED on GPIO8. A plain LED on a GPIO shows the same patterns as
            blink rhythms only, without colour.

        config STATUS_LED_TYPE_WS2812
            bool "WS2812 addressable RGB LED"
        config STATUS_LED_TYPE_GPIO
            bool "Plain LED on a GPIO"
        config STATUS_LED_TYPE_NONE
            bool "No LED"
    endchoice

    config STATUS_LED_GPIO
        int "LED GPIO"
        depends on !STATUS_LED_TYPE_NONE
        default 8
        range 0 30
        help
            GPIO8 is a strapping pin on the ESP32-C6. The DevKit's WS2812 sits
            on it and is fine there; on a custom board prefer a GPIO that is
            not a strapping pin (4, 5, 8, 9 and 15 are).

    config STATUS_LED_GPIO_ACTIVE_HIGH
        bool "GPIO LED is lit when the pin is high"
        depends on STATUS_LED_TYPE_GPIO
        default y

    config STATUS_LED_BRIGHTNESS
        int "WS2812 brightness (0-255)"
        depends on STATUS_LED_TYPE_WS2812
        default 32
        range 1 255
        help
            Full brightness on a bare WS2812 is uncomfortable to look at and
            costs ~50 mA; status only needs to be visible.

endmenu
```

## firmware/esp32/components/user_button/Kconfig
```kconfig
menu "User button"

    config USER_BUTTON_GPIO
        int "Button GPIO"
        default 9
        range 0 30
        help
            GPIO9 is the BOOT button on the ESP32-C6-DevKit. It is a strapping
            pin (held low at reset it selects download mode), which is exactly
            why it is a good choice: the same button flashes the chip and
            drives pairing, and it is wired with a pull-up already.

    config USER_BUTTON_ACTIVE_LOW
        bool "Button pulls the pin low when pressed"
        default y

    config USER_BUTTON_PAIRING_HOLD_MS
        int "Hold time to enter pairing mode (ms)"
        default 3000
        range 1000 30000

    config USER_BUTTON_RESET_HOLD_MS
        int "Hold time for a factory reset (ms)"
        default 10000
        range 2000 60000
        help
            Must be longer than the pairing hold time.

endmenu
```
